## Documentation/devicetree/bindings/display/apple,display-subsystem.yaml
```yaml
# SPDX-License-Identifier: (GPL-2.0 OR BSD-2-Clause)
%YAML 1.2
---
$id: http://devicetree.org/schemas/display/apple,display-subsystem.yaml#
$schema: http://devicetree.org/meta-schemas/core.yaml#

title: Apple display subsystem

maintainers:
  - Ryan Murray <ryan@aurorasilicon.org>

description:
  Component master for one or more Apple display coprocessors. Each IOMMU
  entry describes a scanout DART stream owned by a DCP instance.

properties:
  compatible:
    oneOf:
      - enum:
          - apple,display-subsystem
          - apple,t6031-display-subsystem
          - apple,t6034-display-subsystem
          - apple,t8122-display-subsystem
          - apple,t8132-display-subsystem
      - const: apple,t8132-display-diagnostics
        deprecated: true
      - items:
          - enum:
              - apple,t8140-display-subsystem
              - apple,t8142-display-subsystem
          - const: apple,display-subsystem
      - items:
          - const: apple,t8132-display-subsystem
          - const: apple,t8132-display-diagnostics
        description: Compatibility with kernels predating the common M4 display backend.

  iommus:
    minItems: 1
    maxItems: 8

  memory-region:
    minItems: 1
    maxItems: 64
    description: Reserved memory retaining the inherited display mappings.

  apple,j713-inherited-mappings:
    type: boolean
    description: The loader validated the inherited J713 SID0 scanout mapping.

  apple,dma-range:
    $ref: /schemas/types.yaml#/definitions/uint64-array
    minItems: 2
    maxItems: 2
    description:
      Common scanout DMA aperture, encoded as a base and nonzero size. This
      overrides the default aperture of each referenced DART stream. Other
      consumers of the same DART retain their own apertures.

required:
  - compatible
  - iommus

unevaluatedProperties: false
...
```
